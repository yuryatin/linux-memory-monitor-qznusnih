## meta-lkm-layer/conf/layer.conf
```bitbake
BBPATH .= ":${LAYERDIR}"

BBFILES += "${LAYERDIR}/recipes-*/*/*.bb \
            ${LAYERDIR}/recipes-*/*/*.bbappend"

BBFILE_COLLECTIONS += "meta-lkm-layer"
BBFILE_PATTERN_meta-lkm-layer = "^${LAYERDIR}/"
BBFILE_PRIORITY_meta-lkm-layer = "6"

LAYERDEPENDS_meta-lkm-layer = "core"
LAYERSERIES_COMPAT_meta-lkm-layer = "whinlatter"
```

## meta-lkm-layer/recipes-kernel/lmm_qznusnih/files/Kconfig
```kconfig
config LMM_QZNUSNIH
    tristate "Linux memomy monitor for user space"
    default m
    help
        This Linux kernel module monitors a configurable byte of memory and logs the backtrace that led to the access, with separate handling for read and write operations.
```
